## config/boards/shields/claudia/Kconfig.defconfig
```kconfig
# Copyright (c) 2022 The ZMK Contributors
# SPDX-License-Identifier: MIT

if SHIELD_CLAUDIA

config ZMK_KEYBOARD_NAME
    default "Claudia"

endif
```
